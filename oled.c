#include "oled.h"
#include "Delay.h"

#define I2C_SCL P55
#define I2C_SDA P54

/* 6x8 ASCII字库 */
static code unsigned char ASCII_6x8[][6] = {
    {0x00, 0x00, 0x00, 0x00, 0x00, 0x00},  /* space */
    {0x00, 0x00, 0x5F, 0x00, 0x00, 0x00},  /* ! */
    {0x00, 0x07, 0x00, 0x07, 0x00, 0x00},  /* " */
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    {0x08, 0x1C, 0x2A, 0x08, 0x08, 0x00}   /* <- */
};

/**
 * @brief I2C起始信号
 */
void I2C_Start(void) {
    I2CMSCR = 0x01;
    while (I2CMSST & 0x01);
}

/**
 * @brief I2C停止信号
 */
void I2C_Stop(void) {
    I2CMSCR = 0x06;
    while (I2CMSST & 0x01);
}

/**
 * @brief I2C写入一个字节
 */
void I2C_WriteByte(unsigned char dat) {
    I2CTXD = dat;
    I2CMSCR = 0x02;
    while (I2CMSST & 0x01);
}

/**
 * @brief I2C读取一个字节
 */
unsigned char I2C_ReadByte(unsigned char ack) {
    I2CMSCR = ack ? 0x03 : 0x04;
    while (I2CMSST & 0x01);
    return I2CRXD;
}

/**
 * @brief OLED写入命令
 */
void OLED_WriteCmd(unsigned char cmd) {
    I2C_Start();
    I2C_WriteByte(OLED_ADDR);
    I2C_WriteByte(0x00);
    I2C_WriteByte(cmd);
    I2C_Stop();
}

/**
 * @brief OLED写入数据
 */
void OLED_WriteDat(unsigned char dat) {
    I2C_Start();
    I2C_WriteByte(OLED_ADDR);
    I2C_WriteByte(0x40);
    I2C_WriteByte(dat);
    I2C_Stop();
}

void OLED_Init(void) {
    I2CCFG = 0x81;  // Enable I2C, 100kHz
    Delay_ms(100);
    OLED_WriteCmd(0xAE);  // Display off
    OLED_WriteCmd(0x00);  // Set lower column address
    OLED_WriteCmd(0x10);  // Set higher column address
    OLED_WriteCmd(0x40);  // Set display start line
    OLED_WriteCmd(0xB0);  // Set page address
    OLED_WriteCmd(0x81);  // Set contrast
    OLED_WriteCmd(0xFF);
    OLED_WriteCmd(0xA1);  // Set segment remap
    OLED_WriteCmd(0xA6);  // Normal display
    OLED_WriteCmd(0xA8);  // Set multiplex ratio
    OLED_WriteCmd(0x3F);
    OLED_WriteCmd(0xC8);  // Set COM output scan direction
    OLED_WriteCmd(0xD3);  // Set display offset
    OLED_WriteCmd(0x00);
    OLED_WriteCmd(0xD5);  // Set display clock divide ratio
    OLED_WriteCmd(0x80);
    OLED_WriteCmd(0xD9);  // Set pre-charge period
    OLED_WriteCmd(0xF1);
    OLED_WriteCmd(0xDA);  // Set COM pins hardware configuration
    OLED_WriteCmd(0x12);
    OLED_WriteCmd(0xDB);  // Set VCOMH deselect level
    OLED_WriteCmd(0x30);
    OLED_WriteCmd(0x8D);  // Charge pump
    OLED_WriteCmd(0x14);
    OLED_WriteCmd(0xAF);  // Display on
    OLED_Clear();
}

void OLED_Clear(void) {
    unsigned char i, j;
    for (i = 0; i < 8; i++) {
        OLED_WriteCmd(0xB0 + i);
        OLED_WriteCmd(0x00);
        OLED_WriteCmd(0x10);
        for (j = 0; j < 128; j++) {
            OLED_WriteDat(0x00);
        }
    }
}

/**
 * @brief 显示单个字符
 */
void OLED_ShowChar(unsigned char x, unsigned char y, unsigned char chr) {
    unsigned char i;
    unsigned char c = chr - 32;

    if (x > 122 || y > 7) return;

    OLED_WriteCmd(0xB0 + y);
    OLED_WriteCmd(((x & 0xF0) >> 4) | 0x10);
    OLED_WriteCmd(x & 0x0F);

    for (i = 0; i < 6; i++) {
        OLED_WriteDat(ASCII_6x8[c][i]);
    }
}

/**
 * @brief 显示字符串
 */
void OLED_ShowString(unsigned char x, unsigned char y, unsigned char *str) {
    while (*str) {
        OLED_ShowChar(x, y, *str);
        x += 6;
        if (x > 122) {
            x = 0;
            y++;
        }
        str++;
    }
}

/**
 * @brief 显示整数（带小数点，值已放大10倍）
 * @param x 横坐标
 * @param y 页地址（0-7）
 * @param num 整数（已放大10倍，如253表示25.3）
 * @param decimal_places 小数位数
 */
void OLED_ShowIntWithDecimal(unsigned char x, unsigned char y, int num, unsigned char decimal_places) {
    unsigned char buf[8];
    unsigned char i = 0;
    unsigned char is_negative = 0;
    unsigned char len;

    if (num < 0) {
        is_negative = 1;
        num = -num;
    }

    /* 转换为字符串 */
    do {
        buf[i++] = num % 10 + '0';
        num /= 10;
    } while (num > 0);

    /* 添加小数点 */
    if (decimal_places > 0 && decimal_places < i) {
        /* 将小数点后的数字移到前面 */
        unsigned char j;
        for (j = i; j > decimal_places; j--) {
            buf[j] = buf[j - 1];
        }
        buf[decimal_places] = '.';
        i++;
    }

    if (is_negative) {
        buf[i++] = '-';
    }

    /* 反转字符串 */
    len = i;
    for (i = 0; i < len / 2; i++) {
        unsigned char temp = buf[i];
        buf[i] = buf[len - 1 - i];
        buf[len - 1 - i] = temp;
    }
    buf[len] = '\0';

    OLED_ShowString(x, y, buf);
}

/**
 * @brief 显示整数
 */
void OLED_ShowNum(unsigned char x, unsigned char y, unsigned int num, unsigned char len) {
    unsigned char buf[8];
    unsigned char i = 0;

    /* 抑制未使用参数警告 - len保留用于后续扩展 */
    len = len;

    do {
        buf[i++] = num % 10 + '0';
        num /= 10;
    } while (num > 0);

    /* 反转 */
    {
        unsigned char j;
        for (j = 0; j < i / 2; j++) {
            unsigned char temp = buf[j];
            buf[j] = buf[i - 1 - j];
            buf[i - 1 - j] = temp;
        }
    }
    buf[i] = '\0';

    OLED_ShowString(x, y, buf);
}